## samples/bluetooth/a2dp_source/boards/mimxrt1060_evk_qspi.conf
```kconfig
#select NXP NW612 Chipset (https://www.embeddedartists.com/products/2el-m-2-module)
CONFIG_BT_NXP_NW612=y
#select NXP IW612 Chipset (https://www.embeddedartists.com/products/1xk-m-2-module)
#CONFIG_BT_NXP_IW416=y

CONFIG_BT_A2DP_LOG_LEVEL_DBG=y
#CONFIG_BT_A2DP_LOG_LEVEL_INF=y
#CONFIG_BT_HCI_DRIVER_LOG_LEVEL_INF=y
CONFIG_BT_HCI_DRIVER_LOG_LEVEL_DBG=y

# need to reduce some memory (may be critical)
CONFIG_HEAP_MEM_POOL_SIZE=2400

# Console Logging
CONFIG_LOG=y
CONFIG_CONSOLE=y
CONFIG_UART_CONSOLE=y
CONFIG_LOG_BACKEND_UART=y
CONFIG_BT_LOG_LEVEL_DBG=n
```

## samples/bluetooth/a2dp_source/boards/mimxrt1060_evkb.conf
```kconfig
#select NXP NW612 Chipset (https://www.embeddedartists.com/products/2el-m-2-module)
CONFIG_BT_NXP_NW612=y
#select NXP IW612 Chipset (https://www.embeddedartists.com/products/1xk-m-2-module)
#CONFIG_BT_NXP_IW416=y

CONFIG_BT_LOG_LEVEL_DBG=n

CONFIG_BT_A2DP_LOG_LEVEL_DBG=y
#CONFIG_BT_A2DP_LOG_LEVEL_INF=y

#CONFIG_BT_HCI_DRIVER_LOG_LEVEL_INF=y
CONFIG_BT_HCI_DRIVER_LOG_LEVEL_DBG=y

# need to reduce some memory (may be critical)
CONFIG_HEAP_MEM_POOL_SIZE=2400

# enable for Shell/Logging to UART Console
CONFIG_LOG=y
CONFIG_CONSOLE=y
CONFIG_UART_CONSOLE=y
CONFIG_LOG_BACKEND_UART=y

# enable for Shell/Logging to RTT
CONFIG_USE_SEGGER_RTT=n
CONFIG_RTT_CONSOLE=y
CONFIG_SHELL_BACKEND_RTT=y
#CONFIG_LOG_BACKEND_RTT=y
```

## samples/bluetooth/a2dp_source/boards/mimxrt1170_evk_mimxrt1176_cm7_B.conf
```kconfig
#select NXP NW612 Chipset (https://www.embeddedartists.com/products/2el-m-2-module)
#CONFIG_BT_NXP_NW612=y
#select NXP IW612 Chipset (https://www.embeddedartists.com/products/1xk-m-2-module)
CONFIG_BT_NXP_IW416=y

#CONFIG_BT_A2DP_LOG_LEVEL=BT_LOG_LEVEL_DBG
CONFIG_LOG_DEFAULT_LEVEL=4

# Console Logging
CONFIG_LOG=n
CONFIG_CONSOLE=y
CONFIG_UART_CONSOLE=y
CONFIG_LOG_BACKEND_UART=y
CONFIG_BT_LOG_LEVEL_DBG=n
```

## samples/bluetooth/a2dp_source/sample.yaml
```yaml
sample:
  name: Bluetooth A2dp Source
tests:
  sample.bluetooth.a2dp_source:
    harness: bluetooth
    platform_allow:
      - mimxrt1170_evk@B/mimxrt1176/cm7
      - mimxrt1060_evk@qspi
      - mimxrt1060_evkb
    tags: bluetooth
```
